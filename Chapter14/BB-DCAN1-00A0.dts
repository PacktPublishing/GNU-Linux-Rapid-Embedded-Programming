/dts-v1/;
/plugin/;
 
/ {
 	compatible = "ti,beaglebone", "ti,beaglebone-black";
 
	/* Identification string */
	part-number = "BB-DCAN1-00A0";

        /* Define the pins usage */
        exclusive-use =
		/* the pin header P9 uses */
                "P9.24",
                "P9.26",
                /* Hardware IP cores in use */
                "uart1";
 
	fragment@0 {
		target = <&am33xx_pinmux>;

		__overlay__ {
			dcan1_pins_s0: dcan1_pins_s0 {
				pinctrl-single,pins = <
					0x180 0x12  /* d_can1_tx, SLEWCTRL_FAST | INPUT_PULLUP | MODE2 */
					0x184 0x32  /* d_can1_rx, SLEWCTRL_FAST | RECV_ENABLE | INPUT_PULLUP | MODE2 */
                >;
			};
		};
	};
 
	fragment@1 {
		target = <&dcan1>;

		__overlay__ {
			#address-cells = <1>;
			#size-cells = <0>;
 
			status = "okay";
			pinctrl-names = "default";
			pinctrl-0 = <&dcan1_pins_s0>;
		};
	};
};
