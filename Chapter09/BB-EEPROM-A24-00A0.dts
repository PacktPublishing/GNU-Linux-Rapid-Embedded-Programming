/dts-v1/;
/plugin/;

/ {
	compatible = "ti,beaglebone", "ti,beaglebone-black";

	/* Identification string */
	part-number = "BB-EEPROM-A24";

	/* The version */
	version = "00A0";

	fragment@0 {
		target = <&i2c1>;

		__overlay__ {
			#address-cells	= <1>;
			#size-cells	= <0>;
			status		= "okay";

			/* Set the desired clock frequency */
			clock-frequency	= <400000>;

			/* Define the EEPROM device as based on at24c256
			 * and with I2C address 0x50
			 */
			eeprom: eeprom@50 {
				compatible = "at24,24c02";
				reg	   = <0x50>;
			};
		};
	};
};
