/dts-v1/;
/plugin/;

/ {
	compatible = "ti,beaglebone", "ti,beaglebone-black";

	/* Identification string */
	part-number = "BB-IOEXP-MCP23";

	/* The version */
	version = "00A0";

	fragment@0 {
		target = <&i2c1>;

		__overlay__ {
			#address-cells	= <1>;
			#size-cells	= <0>;
			status		= "okay";

			/* Set the desired clock frequency */
			clock-frequency	= <400000>;

			/* Define the IO Expander device as based on mcp23xxx
			 * and with I2C address 0x20
			 */
			gpio: gpio@20 {
				compatible  = "microchip,mcp23008";
				reg	    = <0x20>;
				gpio-controller;
				#gpio-cells = <2>;
			};
		};
	};
};
