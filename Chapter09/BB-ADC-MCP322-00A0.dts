/dts-v1/;
/plugin/;

/ {
	compatible = "ti,beaglebone", "ti,beaglebone-black";

	/* Identification string */
	part-number = "BB-ADC-MCP322";

	/* The version */
	version = "00A0";

	fragment@0 {
		target = <&i2c1>;

		__overlay__ {
			#address-cells	= <1>;
			#size-cells	= <0>;
			status		= "okay";

			/* Set the desired clock frequency */
			clock-frequency	= <400000>;

			/* Define the ADC device as based on mcp3221
			 * and with I2C address 0x4d
			 */
			adc: adc@4d {
				compatible = "mcp3221";
				reg	   = <0x4d>;
			};
		};
	};
};
